## build/Kconfig/arch/Kconfig.tmp
```kconfig
# Load Zephyr Arch Kconfig descriptions.
osource "/home/viktor/zephyr-standalone/zephyrproject/zephyr/arch/rx/Kconfig"
osource "/home/viktor/zephyr-standalone/zephyrproject/zephyr/arch/x86/Kconfig"
osource "/home/viktor/zephyr-standalone/zephyrproject/zephyr/arch/xtensa/Kconfig"
osource "/home/viktor/zephyr-standalone/zephyrproject/zephyr/arch/sparc/Kconfig"
osource "/home/viktor/zephyr-standalone/zephyrproject/zephyr/arch/riscv/Kconfig"
osource "/home/viktor/zephyr-standalone/zephyrproject/zephyr/arch/posix/Kconfig"
osource "/home/viktor/zephyr-standalone/zephyrproject/zephyr/arch/mips/Kconfig"
osource "/home/viktor/zephyr-standalone/zephyrproject/zephyr/arch/arm64/Kconfig"
osource "/home/viktor/zephyr-standalone/zephyrproject/zephyr/arch/arm/Kconfig"
osource "/home/viktor/zephyr-standalone/zephyrproject/zephyr/arch/arc/Kconfig"
```

## build/Kconfig/boards/Kconfig
```kconfig
# Load Zephyr board Kconfig descriptions.
osource "/home/viktor/zephyr-standalone/zephyrproject/zephyr/boards/weact/blackpill_f411ce/Kconfig"
```

## build/Kconfig/boards/Kconfig.defconfig.tmp
```kconfig
# Load Zephyr board defconfig descriptions.
osource "/home/viktor/zephyr-standalone/zephyrproject/zephyr/boards/weact/blackpill_f411ce/Kconfig.defconfig"
```

## build/Kconfig/soc/Kconfig.tmp
```kconfig
# Load Zephyr SoC Kconfig descriptions.
osource "/home/viktor/zephyr-standalone/zephyrproject/zephyr/soc/xlnx/zynqmp/Kconfig"
osource "/home/viktor/zephyr-standalone/zephyrproject/zephyr/soc/xlnx/zynq7000/Kconfig"
osource "/home/viktor/zephyr-standalone/zephyrproject/zephyr/soc/xlnx/versalnet/Kconfig"
osource "/home/viktor/zephyr-standalone/zephyrproject/zephyr/soc/xlnx/versal2/Kconfig"
osource "/home/viktor/zephyr-standalone/zephyrproject/zephyr/soc/xlnx/versal/Kconfig"
osource "/home/viktor/zephyr-standalone/zephyrproject/zephyr/soc/xen/Kconfig"
osource "/home/viktor/zephyr-standalone/zephyrproject/zephyr/soc/wch/ch32v/Kconfig"
osource "/home/viktor/zephyr-standalone/zephyrproject/zephyr/soc/ti/simplelink/Kconfig"
osource "/home/viktor/zephyr-standalone/zephyrproject/zephyr/soc/ti/mspm0/Kconfig"
osource "/home/viktor/zephyr-standalone/zephyrproject/zephyr/soc/ti/lm3s6965/Kconfig"
osource "/home/viktor/zephyr-standalone/zephyrproject/zephyr/soc/ti/k3/Kconfig"
osource "/home/viktor/zephyr-standalone/zephyrproject/zephyr/soc/telink/tlsr/Kconfig"
osource "/home/viktor/zephyr-standalone/zephyrproject/zephyr/soc/starfive/jh71xx/Kconfig"
osource "/home/viktor/zephyr-standalone/zephyrproject/zephyr/soc/st/stm32/Kconfig"
osource "/home/viktor/zephyr-standalone/zephyrproject/zephyr/soc/snps/qemu_arc/Kconfig"
osource "/home/viktor/zephyr-standalone/zephyrproject/zephyr/soc/snps/nsim/arc_v/Kconfig"
osource "/home/viktor/zephyr-standalone/zephyrproject/zephyr/soc/snps/nsim/arc_classic/Kconfig"
osource "/home/viktor/zephyr-standalone/zephyrproject/zephyr/soc/snps/hsdk4xd/Kconfig"
osource "/home/viktor/zephyr-standalone/zephyrproject/zephyr/soc/snps/hsdk/Kconfig"
osource "/home/viktor/zephyr-standalone/zephyrproject/zephyr/soc/snps/emsk/Kconfig"
osource "/home/viktor/zephyr-standalone/zephyrproject/zephyr/soc/snps/emsdp/Kconfig"
osource "/home/viktor/zephyr-standalone/zephyrproject/zephyr/soc/snps/arc_iot/Kconfig"
osource "/home/viktor/zephyr-standalone/zephyrproject/zephyr/soc/silabs/Kconfig"
osource "/home/viktor/zephyr-standalone/zephyrproject/zephyr/soc/sifli/sf32/Kconfig"
osource "/home/viktor/zephyr-standalone/zephyrproject/zephyr/soc/sifive/sifive_freedom/Kconfig"
osource "/home/viktor/zephyr-standalone/zephyrproject/zephyr/soc/sensry/Kconfig"
osource "/home/viktor/zephyr-standalone/zephyrproject/zephyr/soc/rockchip/Kconfig"
osource "/home/viktor/zephyr-standalone/zephyrproject/zephyr/soc/renode/riscv_virtual/Kconfig"
osource "/home/viktor/zephyr-standalone/zephyrproject/zephyr/soc/renode/cortex_r8_virtual/Kconfig"
osource "/home/viktor/zephyr-standalone/zephyrproject/zephyr/soc/renesas/smartbond/Kconfig"
osource "/home/viktor/zephyr-standalone/zephyrproject/zephyr/soc/renesas/rz/Kconfig"
osource "/home/viktor/zephyr-standalone/zephyrproject/zephyr/soc/renesas/rx/Kconfig"
osource "/home/viktor/zephyr-standalone/zephyrproject/zephyr/soc/renesas/rcar/Kconfig"
osource "/home/viktor/zephyr-standalone/zephyrproject/zephyr/soc/renesas/ra/Kconfig"
osource "/home/viktor/zephyr-standalone/zephyrproject/zephyr/soc/realtek/fingerprint/Kconfig"
osource "/home/viktor/zephyr-standalone/zephyrproject/zephyr/soc/realtek/ec/Kconfig"
osource "/home/viktor/zephyr-standalone/zephyrproject/zephyr/soc/realtek/ameba/Kconfig"
osource "/home/viktor/zephyr-standalone/zephyrproject/zephyr/soc/raspberrypi/rpi_pico/Kconfig"
osource "/home/viktor/zephyr-standalone/zephyrproject/zephyr/soc/quicklogic/eos_s3/Kconfig"
osource "/home/viktor/zephyr-standalone/zephyrproject/zephyr/soc/qemu/virt_riscv/Kconfig"
osource "/home/viktor/zephyr-standalone/zephyrproject/zephyr/soc/qemu/malta/Kconfig"
osource "/home/viktor/zephyr-standalone/zephyrproject/zephyr/soc/openisa/rv32m1/Kconfig"
osource "/home/viktor/zephyr-standalone/zephyrproject/zephyr/soc/openhwgroup/cva6/Kconfig"
osource "/home/viktor/zephyr-standalone/zephyrproject/zephyr/soc/oct/osd32mp15x/Kconfig"
osource "/home/viktor/zephyr-standalone/zephyrproject/zephyr/soc/nxp/s32/Kconfig"
osource "/home/viktor/zephyr-standalone/zephyrproject/zephyr/soc/nxp/rw/Kconfig"
osource "/home/viktor/zephyr-standalone/zephyrproject/zephyr/soc/nxp/mcx/Kconfig"
osource "/home/viktor/zephyr-standalone/zephyrproject/zephyr/soc/nxp/lpc/Kconfig"
osource "/home/viktor/zephyr-standalone/zephyrproject/zephyr/soc/nxp/layerscape/Kconfig"
osource "/home/viktor/zephyr-standalone/zephyrproject/zephyr/soc/nxp/kinetis/Kconfig"
osource "/home/viktor/zephyr-standalone/zephyrproject/zephyr/soc/nxp/imxrt/Kconfig"
osource "/home/viktor/zephyr-standalone/zephyrproject/zephyr/soc/nxp/imx/Kconfig"
osource "/home/viktor/zephyr-standalone/zephyrproject/zephyr/soc/nuvoton/numicro/Kconfig"
osource "/home/viktor/zephyr-standalone/zephyrproject/zephyr/soc/nuvoton/numaker/Kconfig"
osource "/home/viktor/zephyr-standalone/zephyrproject/zephyr/soc/nuvoton/npcx/Kconfig"
osource "/home/viktor/zephyr-standalone/zephyrproject/zephyr/soc/nuvoton/npcm/Kconfig"
osource "/home/viktor/zephyr-standalone/zephyrproject/zephyr/soc/nordic/Kconfig"
osource "/home/viktor/zephyr-standalone/zephyrproject/zephyr/soc/neorv32/Kconfig"
osource "/home/viktor/zephyr-standalone/zephyrproject/zephyr/soc/native/inf_clock/Kconfig"
osource "/home/viktor/zephyr-standalone/zephyrproject/zephyr/soc/microchip/sam/sama7/Kconfig"
osource "/home/viktor/zephyr-standalone/zephyrproject/zephyr/soc/microchip/sam/sam_d5x_e5x/Kconfig"
osource "/home/viktor/zephyr-standalone/zephyrproject/zephyr/soc/microchip/pic64/Kconfig"
osource "/home/viktor/zephyr-standalone/zephyrproject/zephyr/soc/microchip/pic32c/pic32cz_ca/Kconfig"
osource "/home/viktor/zephyr-standalone/zephyrproject/zephyr/soc/microchip/pic32c/pic32cx_sg/Kconfig"
osource "/home/viktor/zephyr-standalone/zephyrproject/zephyr/soc/microchip/pic32c/pic32cm_pl/Kconfig"
osource "/home/viktor/zephyr-standalone/zephyrproject/zephyr/soc/microchip/pic32c/pic32cm_jh/Kconfig"
osource "/home/viktor/zephyr-standalone/zephyrproject/zephyr/soc/microchip/miv/Kconfig"
osource "/home/viktor/zephyr-standalone/zephyrproject/zephyr/soc/microchip/mec/Kconfig"
osource "/home/viktor/zephyr-standalone/zephyrproject/zephyr/soc/mediatek/mt8xxx/Kconfig"
osource "/home/viktor/zephyr-standalone/zephyrproject/zephyr/soc/lowrisc/opentitan/Kconfig"
osource "/home/viktor/zephyr-standalone/zephyrproject/zephyr/soc/litex/litex_vexriscv/Kconfig"
osource "/home/viktor/zephyr-standalone/zephyrproject/zephyr/soc/ite/ec/Kconfig"
osource "/home/viktor/zephyr-standalone/zephyrproject/zephyr/soc/intel/wildcat_lake/Kconfig"
osource "/home/viktor/zephyr-standalone/zephyrproject/zephyr/soc/intel/raptor_lake/Kconfig"
osource "/home/viktor/zephyr-standalone/zephyrproject/zephyr/soc/intel/panther_lake/Kconfig"
osource "/home/viktor/zephyr-standalone/zephyrproject/zephyr/soc/intel/lakemont/Kconfig"
osource "/home/viktor/zephyr-standalone/zephyrproject/zephyr/soc/intel/intel_socfpga_std/Kconfig"
osource "/home/viktor/zephyr-standalone/zephyrproject/zephyr/soc/intel/intel_socfpga/Kconfig"
osource "/home/viktor/zephyr-standalone/zephyrproject/zephyr/soc/intel/intel_niosv/Kconfig"
osource "/home/viktor/zephyr-standalone/zephyrproject/zephyr/soc/intel/intel_ish/Kconfig"
osource "/home/viktor/zephyr-standalone/zephyrproject/zephyr/soc/intel/intel_adsp/Kconfig"
osource "/home/viktor/zephyr-standalone/zephyrproject/zephyr/soc/intel/elkhart_lake/Kconfig"
osource "/home/viktor/zephyr-standalone/zephyrproject/zephyr/soc/intel/atom/Kconfig"
osource "/home/viktor/zephyr-standalone/zephyrproject/zephyr/soc/intel/apollo_lake/Kconfig"
osource "/home/viktor/zephyr-standalone/zephyrproject/zephyr/soc/intel/alder_lake/Kconfig"
osource "/home/viktor/zephyr-standalone/zephyrproject/zephyr/soc/infineon/psoc4/Kconfig"
osource "/home/viktor/zephyr-standalone/zephyrproject/zephyr/soc/infineon/edge/Kconfig"
osource "/home/viktor/zephyr-standalone/zephyrproject/zephyr/soc/infineon/cat3/Kconfig"
osource "/home/viktor/zephyr-standalone/zephyrproject/zephyr/soc/infineon/cat1c/Kconfig"
osource "/home/viktor/zephyr-standalone/zephyrproject/zephyr/soc/infineon/cat1b/Kconfig"
osource "/home/viktor/zephyr-standalone/zephyrproject/zephyr/soc/infineon/cat1a/Kconfig"
osource "/home/viktor/zephyr-standalone/zephyrproject/zephyr/soc/gd/gd32/Kconfig"
osource "/home/viktor/zephyr-standalone/zephyrproject/zephyr/soc/gaisler/leon3/Kconfig"
osource "/home/viktor/zephyr-standalone/zephyrproject/zephyr/soc/gaisler/gr716a/Kconfig"
osource "/home/viktor/zephyr-standalone/zephyrproject/zephyr/soc/focaltech/Kconfig"
osource "/home/viktor/zephyr-standalone/zephyrproject/zephyr/soc/espressif/Kconfig"
osource "/home/viktor/zephyr-standalone/zephyrproject/zephyr/soc/ene/kb1200/Kconfig"
osource "/home/viktor/zephyr-standalone/zephyrproject/zephyr/soc/ene/kb106x/Kconfig"
osource "/home/viktor/zephyr-standalone/zephyrproject/zephyr/soc/elan/em32f967/Kconfig"
osource "/home/viktor/zephyr-standalone/zephyrproject/zephyr/soc/egis/Kconfig"
osource "/home/viktor/zephyr-standalone/zephyrproject/zephyr/soc/efinix/sapphire/Kconfig"
osource "/home/viktor/zephyr-standalone/zephyrproject/zephyr/soc/cdns/xtensa_sample_controller/Kconfig"
osource "/home/viktor/zephyr-standalone/zephyrproject/zephyr/soc/cdns/sample_controller32/Kconfig"
osource "/home/viktor/zephyr-standalone/zephyrproject/zephyr/soc/cdns/dc233c/Kconfig"
osource "/home/viktor/zephyr-standalone/zephyrproject/zephyr/soc/brcm/bcmvk/Kconfig"
osource "/home/viktor/zephyr-standalone/zephyrproject/zephyr/soc/brcm/bcm2712/Kconfig"
osource "/home/viktor/zephyr-standalone/zephyrproject/zephyr/soc/brcm/bcm2711/Kconfig"
osource "/home/viktor/zephyr-standalone/zephyrproject/zephyr/soc/blackberry/qnxhv_vm/Kconfig"
osource "/home/viktor/zephyr-standalone/zephyrproject/zephyr/soc/bflb/Kconfig"
osource "/home/viktor/zephyr-standalone/zephyrproject/zephyr/soc/atmel/sam0/Kconfig"
osource "/home/viktor/zephyr-standalone/zephyrproject/zephyr/soc/atmel/sam/Kconfig"
osource "/home/viktor/zephyr-standalone/zephyrproject/zephyr/soc/aspeed/Kconfig"
osource "/home/viktor/zephyr-standalone/zephyrproject/zephyr/soc/arm/Kconfig"
osource "/home/viktor/zephyr-standalone/zephyrproject/zephyr/soc/arm/beetle/Kconfig"
osource "/home/viktor/zephyr-standalone/zephyrproject/zephyr/soc/antmicro/myra/Kconfig"
osource "/home/viktor/zephyr-standalone/zephyrproject/zephyr/soc/andestech/Kconfig"
osource "/home/viktor/zephyr-standalone/zephyrproject/zephyr/soc/amd/acp_6_0/Kconfig"
osource "/home/viktor/zephyr-standalone/zephyrproject/zephyr/soc/ambiq/Kconfig"
osource "/home/viktor/zephyr-standalone/zephyrproject/zephyr/soc/allwinner/sun8i_h3/Kconfig"
osource "/home/viktor/zephyr-standalone/zephyrproject/zephyr/soc/aesc/Kconfig"
osource "/home/viktor/zephyr-standalone/zephyrproject/zephyr/soc/adi/max32/Kconfig"
```
